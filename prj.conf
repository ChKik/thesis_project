## CMakeLists.txt
```
# SPDX-License-Identifier: Apache-2.0

cmake_minimum_required(VERSION 3.20.0)

find_package(Zephyr REQUIRED HINTS $ENV{ZEPHYR_BASE})
project(thesis_project)

#To pira apo to magic wand sample, Pithanos na to xreiastw kai sto diko moy project.
# These samples use local static initialization. Since Zephyr doesn't support the
# C++ ABI for thread-safe initialization of local statics and the constructors don't
# appear to require thread safety, we turn it off in the C++ compiler.
set(NO_THREADSAFE_STATICS $<TARGET_PROPERTY:compiler-cpp,no_threadsafe_statics>)
zephyr_compile_options($<$<COMPILE_LANGUAGE:CXX>:${NO_THREADSAFE_STATICS}>)


set(TFLITE_MICRO_KERNELS_DIR "${ZEPHYR_TFLITE_MODULE_DIR}/tensorflow/lite/micro/kernels/cmsis-nn") #much more memory efficient if we can use CMSIS-NN,den allakse tipota.

list(APPEND EXTRA_ZEPHYR_MODULES
    ${ZEPHYR_TFLITE_MODULE_DIR}           # Links TFLite Micro library
)

target_include_directories(app PRIVATE
    ${CMAKE_CURRENT_SOURCE_DIR}/images_directory
)

file(GLOB IMAGE_SOURCES ${CMAKE_CURRENT_SOURCE_DIR}/images_directory/*.cc)

target_sources(app PRIVATE
    src/main.cc
    src/gesture_model.cc
    src/model_data.cc
    src/output_handler.cc
    ${IMAGE_SOURCES}
)
```

## sample.yaml
```
sample:
  description: project for my thesis in vision AI
    application
  name: My zephyr thesis project for the renesas ek_ra8d1 board.
common:
  min_ram: 2
  min_flash: 16
  tags: introduction
  integration_platforms:
    - native_sim
  harness: console
  harness_config:
    type: one_line
    regex:
      - "Vision AI TEST! (.*)"
tests:
  sample.basic.helloworld:
    tags: introduction
```

## prj.conf
```kconfig
# Basic console output
CONFIG_PRINTK=y
CONFIG_CONSOLE=y
CONFIG_UART_CONSOLE=y
CONFIG_ERRNO=y                # For strerror()


# Logging configuration
CONFIG_LOG=y
CONFIG_LOG_BACKEND_UART=y
CONFIG_LOG_MODE_IMMEDIATE=y
CONFIG_FLASH_LOG_LEVEL_DBG=y

# Flash configuration 
CONFIG_FLASH=y
CONFIG_FLASH_MAP=y
CONFIG_FLASH_PAGE_LAYOUT=y

# For Tensorflow Lite.
#vazw sugkekrimena tin C++ 17 gia na mporei na xrisimopoiei sugkekrimena types poy den yparxoyn stin C++11 poy einai by default.
CONFIG_CPP=y
CONFIG_STD_CPP17=y #kathorizei to version tis C++ poy trexei.
CONFIG_REQUIRES_FULL_LIBC=y
CONFIG_TENSORFLOW_LITE_MICRO=y
CONFIG_TENSORFLOW_LITE_MICRO_CMSIS_NN_KERNELS=y #Enable CMSIS-NN for acceleration . Only for ARM Cortex-M Cores.

# Memory , mporei na thelei adjust analoga. Reduced to stack size so that the model fits
CONFIG_MAIN_STACK_SIZE=4096
# Minimal heap for Zephyr OS operations. Reduced to dynamic allocation  so that the model fits
CONFIG_HEAP_MEM_POOL_SIZE=1024 
```

## src/main.c
```c
#include <zephyr/kernel.h>
#include <zephyr/logging/log.h>
#include <string.h>
#include "image.h"


LOG_MODULE_REGISTER(thesis_project);

/* mporw na valw kai DMA sto mellon mias kai to ypostirizei to zephyr*/

#define SRAM1_BASE_ADDR 0x22060000  // Secure alias (or 0x32060000 for non-secure) sumfwna me to memory mapping.
#define SRAM1_SIZE      512 * 1024   // 512KB

/* Pointer to SRAM1 */
volatile uint8_t * const sram1 = (uint8_t *)SRAM1_BASE_ADDR;  //volatile giati o pointer mporei na allaksei thesi.

int main(void)
{
    /* ver so that image fits in SRAM */
    if (sizeof(image_jpeg) > SRAM1_SIZE) {
        LOG_ERR("Image too large for SRAM1!");
        return -ENOMEM;
    }

    /* Apeuthias. memory copy stin RAM xwris na xreiazetai erase opws stin flash mnimi */
    memcpy((void *)sram1, image_jpeg, sizeof(image_jpeg));  //me pointer doulevei ousiastika mono.

    if (memcmp(image_jpeg, (void *)sram1, sizeof(image_jpeg)) == 0) {
        LOG_INF("SRAM write successful!");
        LOG_INF("Image copied to 0x%08x, size %zu bytes", 
               SRAM1_BASE_ADDR, sizeof(image_jpeg));
    } else {
        LOG_ERR("SRAM verification failed!");
        return -EIO;
    }
      
    bool verify = memcmp(image_jpeg, (void *)SRAM1_BASE_ADDR, sizeof(image_jpeg)) == 0;
    LOG_INF("SRAM verification: %s", verify ? "PASSED" : "FAILED");

    /* Hex dump first 32 bytes kai verification */
    LOG_INF("First 32 bytes:");
    for (int i = 0; i < 32; i++) {
        printk("%02x ", ((uint8_t *)SRAM1_BASE_ADDR)[i]);
        if ((i+1) % 16 == 0) printk("\n"); //gia allagh grammis apla.
    }

    return 0;
}
```

## src/main.cc
```c
#include <zephyr/kernel.h>  //auto to vriskei aytomata apo to zephyrbase poy kaneis source. To evala kai sto sto path gia na to vriskei to vscode.
#include "gesture_model.hpp"
#include "output_handler.hpp"
#include "constants.hpp"

#include  "all_images.h"


unsigned int iteration_counter=0;

namespace {
    GestureModel model;
}
/*//eprepe na to allaksw gia na min exei conflict me to Zephyr main kai gia na mporei na to vrei to zephyr. 
Epeidh einai C++ file kai ta Zephyr headers kanoyn declare extern int main(void);  gia to   entrypoint
Exei diko toy Zephyr declaration diladi.*/
extern "C" int main(void){  
    if (!model.Init()) {
        MicroPrintf("Failed to initialize model");
        return -1;
    }

    while (iteration_counter<num_images) {  //to vazw na trexei mono 3 fores pros to parwn to prediction tis eikonas.
        
        const unsigned char* data = all_images[iteration_counter].data;
        unsigned int len = all_images[iteration_counter].length;

        uint8_t* input = model.GetInputBuffer();
        memcpy(input, data, len);

         /* ---- TIMER START ---- */
        uint32_t start_time = (uint32_t)k_uptime_get_32();
       

        // Run inference
        if (!model.Predict()) {
            MicroPrintf("Prediction failed");
            k_msleep(100);
            continue;
        }

         /* ---- TIMER END ---- */
        uint32_t end_time = (uint32_t)k_uptime_get_32();
        uint32_t elapsed = end_time - start_time;

        MicroPrintf("Inference %u took %u ms", iteration_counter, elapsed);


        // Handle results of the predictions and output on Picocom
        HandleOutput(model.GetPrediction());
        
        iteration_counter++;
        k_msleep(100); 
        
    }
    return 0;
}
```

## src/constants.hpp
```c
#ifndef CONSTANTS_HPP
#define CONSTANTS_HPP

#define KILOBYTE_NUM 880
//constexpr giati everything is provided at compile time the function can be evaluated at compile time. 
namespace {
    constexpr int kGestureCount = 20;
    constexpr int kImageWidth = 224;
    constexpr int kImageHeight = 224;
    constexpr int kChannels = 3;
    constexpr int kTensorArenaSize = KILOBYTE_NUM * 1024; // global static buffer ginetai allocated sto link time oxi dynamically.
}

// na checkarw to max megethos poy mporei na exei o tensoras , mesw toy compile.


// META TIS ALLAGES TIS CONST EIKONAS/BUFFER ME TIN RAM
//800       | thelei parapanw to arena
//850       | compiled kai doulevei to model <-- To palio model nai to new oxi
//860       | test gia to new model. Oxi den mporei
//880       | kanei build oriaka


#endif // CONSTANTS_H
```

## src/gesture_model.cc
```c
#include "gesture_model.hpp"
#include "constants.hpp"
#include <tensorflow/lite/micro/micro_log.h> 
#include <tensorflow/lite/micro/micro_mutable_op_resolver.h>
#include "zephyr_const_includers.h"


GestureModel::GestureModel() : 
    model_(tflite::GetModel(zephyr_quantized_int8_tflite)), // pairnei ta weights apo to model_data.cc
    interpreter_(nullptr) {}


bool GestureModel::Init() {
    //verify oti exei perasei to tflite stin flash mnimi
    MicroPrintf("Model flash address: %p ", 
        zephyr_quantized_int8_tflite);
    
    //debug section.
    MicroPrintf("===== GestureModel::Init() =====");
    MicroPrintf("Model flatbuffer version: %d", model_->version());
    MicroPrintf("Model address: %p", zephyr_quantized_int8_tflite);
    MicroPrintf("Model arena size: %d bytes", kTensorArenaSize);
    MicroPrintf("Tensor arena location: 0x%p - 0x%p", tensor_arena_, tensor_arena_ + kTensorArenaSize);

    static tflite::MicroMutableOpResolver<8> resolver; 
    
   //  operators with debug output
    MicroPrintf("Registering operators...");
    if (resolver.AddAdd() != kTfLiteOk) MicroPrintf("Failed to register Add");
    if (resolver.AddMean() != kTfLiteOk) MicroPrintf("Failed to register Mean");
    if (resolver.AddConv2D() != kTfLiteOk) MicroPrintf("Failed to register Conv2D");
    if (resolver.AddDepthwiseConv2D() != kTfLiteOk) MicroPrintf("Failed to register DepthwiseConv2D");
    if (resolver.AddAveragePool2D() != kTfLiteOk) MicroPrintf("Failed to register AveragePool2D");
    if (resolver.AddFullyConnected() != kTfLiteOk) MicroPrintf("Failed to register FullyConnected");
    if (resolver.AddSoftmax() != kTfLiteOk) MicroPrintf("Failed to register Softmax");
    if (resolver.AddQuantize() != kTfLiteOk) MicroPrintf("Failed to register Quantize");

    static tflite::MicroInterpreter interpreter(
        model_, resolver, tensor_arena_, sizeof(tensor_arena_));
    
    interpreter_ = &interpreter;
    

    if (interpreter_->AllocateTensors() != kTfLiteOk) {
        MicroPrintf("Tensor allocation failed");  //edw failarei to flash. Den exei arketo xwro to arena space.
        MicroPrintf("Tried to allocate %zu bytes (arena: %zu)", 
                    interpreter_->arena_used_bytes(), kTensorArenaSize);
        return false;
    }

    //verify gia to memory usage allocation 
    MicroPrintf("SRAM usage: %zu/%zu bytes (Arena: 0x%p - 0x%p)",
           interpreter_->arena_used_bytes(),
           kTensorArenaSize,  //einai sto constants.hpp
           tensor_arena_,   //einai sto gesture_model.hpp
           tensor_arena_ + kTensorArenaSize);


    input_ = interpreter_->input(0);
    output_ = interpreter_->output(0);

    // Verify input matches our constants
    if (input_->dims->data[1] != kImageWidth || 
        input_->dims->data[2] != kImageHeight ||
        input_->dims->data[3] != kChannels) {
        MicroPrintf("Bad input dimensions");
        return false;
    }

    return true;
}

uint8_t* GestureModel::GetInputBuffer() {
    return input_->data.uint8;  //to input_ kai data einai tflite tensors
     // tha prepei na kanw load tin eikona kai na tin diavasw apo tin sram
    // opws to eixa kanei paliotera. tha thelei quantize prwta omws.
}

bool GestureModel::Predict() {
    //validation gia to memory validation
    size_t pre_invoke_usage = interpreter_->arena_used_bytes();
    if (interpreter_->Invoke() != kTfLiteOk) return false;
    
    MicroPrintf("Peak RAM usage: %zu bytes (Delta: %zu)",
               interpreter_->arena_used_bytes(),
               interpreter_->arena_used_bytes() - pre_invoke_usage);
    return true;
}

int GestureModel::GetPrediction() const {
    uint8_t* scores = output_->data.uint8;
    int max_idx = 0;
    for (int i = 1; i < kGestureCount; i++) {
        if (scores[i] > scores[max_idx]) {
            max_idx = i;
        }
    }
    return max_idx;
}
```

## src/gesture_model.hpp
```c
#ifndef GESTURE_MODEL_HPP
#define GESTURE_MODEL_HPP

#include "constants.hpp"
#include <tensorflow/lite/micro/micro_interpreter.h>



class GestureModel {
public:
    GestureModel();
    bool Init();
    uint8_t* GetInputBuffer();
    bool Predict();
    int GetPrediction() const;

private:
    alignas(16) uint8_t tensor_arena_[kTensorArenaSize];  //CMSIS-NN requires 16-byte alignmen
    const tflite::Model* model_;
    tflite::MicroInterpreter* interpreter_;
    TfLiteTensor* input_;
    TfLiteTensor* output_;
};

#endif // GESTURE_MODEL_H
```

## src/image.h
```c
unsigned char image_jpeg[] = {
  0xff, 0xd8, 0xff, 0xe0, 0x00, 0x10, 0x4a, 0x46, 0x49, 0x46, 0x00, 0x01,
  0x01, 0x00, 0x00, 0x01, 0x00, 0x01, 0x00, 0x00, 0xff, 0xdb, 0x00, 0x84,
  0x00, 0x09, 0x06, 0x07, 0x12, 0x12, 0x12, 0x12, 0x12, 0x0f, 0x12, 0x12,
  0x15, 0x15, 0x10, 0x10, 0x15, 0x11, 0x15, 0x16, 0x12, 0x12, 0x15, 0x16,
  0x17, 0x10, 0x12, 0x15, 0x15, 0x16, 0x17, 0x17, 0x12, 0x15, 0x17, 0x18,
  0x1c, 0x28, 0x20, 0x1a, 0x1a, 0x25, 0x1b, 0x15, 0x15, 0x21, 0x31, 0x21,
  0x25, 0x29, 0x2b, 0x2e, 0x2e, 0x2e, 0x17, 0x1f, 0x33, 0x38, 0x33, 0x2d,
  0x37, 0x28, 0x2d, 0x2e, 0x2b, 0x01, 0x0a, 0x0a, 0x0a, 0x0e, 0x0d, 0x0e,
  0x1b, 0x10, 0x10, 0x1b, 0x2d, 0x26, 0x20, 0x25, 0x30, 0x2d, 0x30, 0x2d,
  0x2d, 0x2b, 0x37, 0x2f, 0x2d, 0x2d, 0x35, 0x2d, 0x2d, 0x2b, 0x2d, 0x2f,
  0x2d, 0x2d, 0x2d, 0x2d, 0x2d, 0x2d, 0x2d, 0x2d, 0x2d, 0x2d, 0x2d, 0x2d,
  0x2d, 0x2d, 0x2f, 0x2d, 0x2d, 0x2d, 0x2d, 0x2d, 0x2b, 0x2d, 0x2d, 0x2d,
  0x2d, 0x2d, 0x2b, 0x2d, 0x2d, 0x2d, 0x2d, 0x2d, 0x2d, 0x2d, 0xff, 0xc0,
  0x00, 0x11, 0x08, 0x00, 0xb6, 0x01, 0x15, 0x03, 0x01, 0x22, 0x00, 0x02,
  0x11, 0x01, 0x03, 0x11, 0x01, 0xff, 0xc4, 0x00, 0x1b, 0x00, 0x01, 0x00,
  0x02, 0x03, 0x01, 0x01, 0x00, 0x00, 0x00, 0x00, 0x00, 0x00, 0x00, 0x00,
  0x00, 0x00, 0x00, 0x05, 0x06, 0x01, 0x03, 0x04, 0x02, 0x07, 0xff, 0xc4,
  0x00, 0x41, 0x10, 0x00, 0x02, 0x01, 0x02, 0x02, 0x04, 0x0b, 0x05, 0x05,
  0x06, 0x07, 0x01, 0x00, 0x00, 0x00, 0x00, 0x00, 0x01, 0x02, 0x03, 0x11,
  0x04, 0x21, 0x05, 0x06, 0x31, 0x41, 0x12, 0x13, 0x32, 0x51, 0x61, 0x71,
  0x81, 0x91, 0xb1, 0xc1, 0xd1, 0x14, 0x22, 0x42, 0x52, 0x72, 0x23, 0x62,
  0x92, 0xa1, 0xf0, 0x16, 0x43, 0x53, 0x82, 0xd2, 0xe1, 0x07, 0x33, 0x63,
  0x83, 0xa2, 0xb2, 0xc2, 0x15, 0xff, 0xc4, 0x00, 0x19, 0x01, 0x01, 0x00,
  0x03, 0x01, 0x01, 0x00, 0x00, 0x00, 0x00, 0x00, 0x00, 0x00, 0x00, 0x00,
  0x00, 0x00, 0x00, 0x02, 0x03, 0x04, 0x01, 0x05, 0xff, 0xc4, 0x00, 0x23,
  0x11, 0x01, 0x00, 0x02, 0x02, 0x01, 0x04, 0x03, 0x00, 0x03, 0x00, 0x00,
  0x00, 0x00, 0x00, 0x00, 0x00, 0x00, 0x01, 0x02, 0x03, 0x11, 0x51, 0x04,
  0x13, 0x14, 0x31, 0x12, 0x21, 0x41, 0x22, 0x32, 0x61, 0xff, 0xda, 0x00,
  0x0c, 0x03, 0x01, 0x00, 0x02, 0x11, 0x03, 0x11, 0x00, 0x3f, 0x00, 0xfb,
  0x88, 0x00, 0x00, 0x00, 0x00, 0x00, 0x00, 0x00, 0x00, 0x00, 0x00, 0x00,
  0x00, 0x00, 0x00, 0x00, 0x00, 0x00, 0x00, 0x00, 0x00, 0x00, 0x00, 0x00,
  0x00, 0x00, 0x00, 0x00, 0x00, 0x00, 0x00, 0x00, 0x00, 0x00, 0x00, 0x00,
  0x00, 0x00, 0x00, 0x00, 0x00, 0x00, 0x00, 0x00, 0x00, 0x00, 0x00, 0x00,
  0x00, 0x00, 0x00, 0x00, 0x00, 0x00, 0x00, 0x00, 0x00, 0x00, 0x00, 0x00,
  0x00, 0x00, 0x00, 0x00, 0x00, 0x00, 0x00, 0x00, 0x00, 0x00, 0x00, 0x00,
  0x00, 0x00, 0x00, 0x00, 0x00, 0x00, 0x00, 0x00, 0x00, 0x00, 0x00, 0x00,
  0x00, 0x06, 0x1b, 0x03, 0x20, 0xae, 0x60, 0x71, 0xf3, 0x73, 0xe1, 0xca,
  0x4e, 0xd3, 0x93, 0xf7, 0x6f, 0x92, 0x8d, 0xf2, 0x49, 0x75, 0x16, 0x32,
  0x35, 0xb4, 0x59, 0x66, 0x4c, 0x53, 0x4d, 0x6c, 0x00, 0x12, 0x56, 0x00,
  0x00, 0x00, 0x00, 0x00, 0x00, 0x00, 0x00, 0x00, 0x00, 0x00, 0x00, 0x00,
  0x00, 0x00, 0x00, 0x00, 0x00, 0x00, 0x00, 0x00, 0x00, 0x00, 0x00, 0x00,
  0x00, 0x00, 0x00, 0x00, 0x00, 0x10, 0x7a, 0xc7, 0x8f, 0xb2, 0x54, 0x60,
  0xfd, 0xea, 0x9c, 0xab, 0x6d, 0x8d, 0x3d, 0xfd, 0xaf, 0x67, 0x79, 0xd1,
  0xa5, 0xb4, 0xaa, 0xa7, 0xee, 0xc2, 0xd2, 0xa8, 0xf6, 0x2d, 0xd1, 0xe9,
  0x97, 0xa1, 0x5f, 0xc3, 0x52, 0x7c, 0x29, 0x4e, 0x6d, 0xb9, 0x49, 0xdd,
  0xb7, 0xb5, 0xb2, 0x9c, 0x97, 0xd7, 0xd4, 0x35, 0x74, 0xf8, 0x77, 0x3f,
  0x29, 0xf4, 0xea, 0xc3, 0x53, 0xf7, 0xa1, 0x15, 0xd0, 0x8b, 0x52, 0x21,
  0xf4, 0x3e, 0x1a, 0xed, 0xd4, 0x7d, 0x51, 0xf3, 0x7e, 0x44, 0xc1, 0xdc,
  0x51, 0xf5, 0xb3, 0xaa, 0xbc, 0x5a, 0xda, 0x8f, 0xc0, 0x00, 0x5a, 0xca,
  0x00, 0x00, 0x00, 0x00, 0x00, 0x00, 0x00, 0x00, 0x00, 0x00, 0x00, 0x00,
  0x00, 0x00, 0x00, 0x00, 0x00, 0x00, 0x02, 0x2a, 0x86, 0x9f, 0xa3, 0x2e,
  0x53, 0x70, 0x7f, 0x79, 0x65, 0xde, 0xae, 0x89, 0x1a, 0x35, 0xa3, 0x25,
  0x78, 0x49, 0x49, 0x73, 0xc5, 0xa7, 0xe0, 0x46, 0x2d, 0x13, 0xea, 0x52,
  0xb5, 0x2d, 0x5f, 0x70, 0xd8, 0x00, 0x24, 0x88, 0x00, 0x00, 0x00, 0x00,
  0x00, 0x00, 0x46, 0x69, 0xbd, 0x23, 0xc5, 0x45, 0x46, 0x3c, 0xb9, 0xe5,
  0x1f, 0xba, 0xbe, 0x66, 0x76, 0xe2, 0xb1, 0x11, 0xa7, 0x17, 0x39, 0xbb,
  0x28, 0xab, 0xfa, 0x25, 0xd2, 0xca, 0x6c, 0x6a, 0xca, 0xad, 0x47, 0x52,
  0x7b, 0x64, 0xf2, 0x5f, 0x2a, 0xdd, 0x12, 0xbb, 0xdb, 0x51, 0xa8, 0x5d,
  0x87, 0x1f, 0xca, 0x77, 0x3e, 0x9d, 0x1a, 0x3e, 0x8e, 0xd7, 0x2c, 0xdb,
  0xde, 0xf3, 0xef, 0x3a, 0x29, 0xd2, 0xe1, 0x4a, 0x31, 0x59, 0x70, 0xa5,
  0x63, 0x6d, 0x28, 0x25, 0xb0, 0xd7, 0x89, 0xac, 0xa2, 0xaf, 0xbd, 0x3f,
  0x03, 0x3d, 0xb5, 0x0d, 0xf1, 0x33, 0x3e, 0x96, 0x58, 0x41, 0x24, 0x92,
  0xd8, 0x95, 0x91, 0xe8, 0xac, 0x61, 0xf4, 0xcc, 0xd3, 0xe0, 0xde, 0xf6,
  0xcd, 0xf0, 0xb3, 0xc9, 0xf2, 0x7f, 0x5d, 0x07, 0x56, 0x17, 0x58, 0xa3,
  0x2d, 0xb1, 0x76, 0xe7, 0x8d, 0xdf, 0x6e, 0xc2, 0xf8, 0xcd, 0x56, 0x2b,
  0x74, 0xb9, 0x23, 0xfd, 0x4e, 0x83, 0x56, 0x1f, 0x11, 0x19, 0xab, 0xc5,
  0xdf, 0xcb, 0xac, 0xda, 0x5b, 0x13, 0xb5, 0x13, 0x1a, 0xfa, 0x90, 0x18,
  0x93, 0xb6, 0x6f, 0x71, 0x1f, 0x5b, 0x4c, 0x53, 0x5c, 0x9b, 0xcb, 0xab,
  0x67, 0x7b, 0x39, 0x33, 0x11, 0xed, 0xda, 0xd6, 0x6d, 0xe9, 0x22, 0x08,
  0x79, 0xe9, 0xb5, 0xf0, 0xc3, 0xbd, 0x9a, 0xd6, 0x9a, 0x97, 0xcb, 0x1e,
  0xf6, 0x43, 0xbb, 0x5e, 0x53, 0xec, 0x5f, 0x84, 0xe0, 0x22, 0x61, 0xa6,
  0x97, 0xc5, 0x07, 0xd8, 0xcf, 0x13, 0xd3, 0xf1, 0x5f, 0x04, 0xbb, 0xd0,
  0xee, 0xd7, 0x93, 0xb3, 0x7e, 0x13, 0x20, 0x82, 0x7a, 0xc1, 0xfe, 0x9f,
  0xfc, 0xbf, 0xb1, 0xe2, 0x7a, 0xc3, 0x2d, 0xd4, 0xe3, 0xdb, 0x27, 0xe8,
  0x73, 0xbd, 0x4e, 0x5d, 0x8e, 0x9f, 0x27, 0x0b, 0x00, 0x2a, 0xf5, 0x35,
  0x8a, 0xae, 0xe8, 0xc1, 0x76, 0x37, 0xe6, 0x73, 0xd4, 0xd3, 0x95, 0xdf,
  0xc4, 0x97, 0x54, 0x57, 0x9d, 0xc8, 0xcf, 0x51, 0x44, 0xe3, 0xa5, 0xc8,
  0xb8, 0x18, 0x6c, 0xa4, 0x54, 0xd2, 0x15, 0xa5, 0xb6, 0xac, 0xfb, 0x25,
  0x6f, 0x03, 0x9a, 0x72, 0x72, 0xe5, 0x49, 0xbf, 0xa9, 0xb7, 0xe2, 0x42,
  0x7a, 0xa8, 0xfc, 0x84, 0xe3, 0xa3, 0xb7, 0xec, 0xaf, 0x35, 0x31, 0xb4,
  0xa3, 0xca, 0xa9, 0x05, 0xd7, 0x25, 0xea, 0x68, 0x9e, 0x99, 0xa0, 0xbf,
  0x78, 0xbb, 0x13, 0x7e, 0x08, 0xa5, 0xd8, 0xc3, 0x44, 0x67, 0xaa, 0x9f,
  0xc8, 0x59, 0x1d, 0x1c, 0x7e, 0xca, 0xdb, 0x3d, 0x62, 0xa0, 0xb6, 0x70,
  0xdf, 0x54, 0x7d, 0x6c, 0x73, 0xd4, 0xd6, 0x88, 0x7c, 0x34, 0xe4, 0xfa,
  0xda, 0x5e, 0x17, 0x2b, 0x26, 0x1a, 0x21, 0x3d, 0x45, 0xd2, 0x8e, 0x93,
  0x1c, 0x2c, 0x3f, 0xb4, 0xef, 0x75, 0x25, 0xf8, 0xdf, 0xa0, 0x2b, 0xe9,
  0x83, 0x9d, 0xfb, 0xf2, 0x97, 0x8d, 0x8f, 0x87, 0x63, 0x81, 0x85, 0x4b,
  0x3b, 0xab, 0xa7, 0xce, 0xb2, 0x7f, 0x91, 0xd3, 0xc1, 0x32, 0xa0, 0x57,
  0xa5, 0x9b, 0x62, 0x9e, 0x3e, 0xbc, 0x76, 0x55, 0x97, 0xf3, 0x5a, 0x5e,
  0x2a, 0xe7, 0x55, 0x3d, 0x3d, 0x59, 0x72, 0xa3, 0x09, 0x76, 0x35, 0xe6,
  0x73, 0x70, 0x0c, 0x3a, 0x64, 0xa2, 0xf7, 0x8f, 0x52, 0x84, 0xe3, 0xc7,
  0x3e, 0xe1, 0x25, 0x0d, 0x63, 0xf9, 0xa9, 0x3e, 0xc9, 0xdf, 0xc5, 0x1b,
  0x3f, 0x68, 0xe3, 0xfc, 0x39, 0xf7, 0xc7, 0xd4, 0x89, 0x50, 0x0a, 0x08,
  0x9f, 0x7f, 0x22, 0x1e, 0x3e, 0x3e, 0x13, 0x11, 0xd6, 0x28, 0x6f, 0xa7,
  0x51, 0x7e, 0x1f, 0x53, 0x62, 0xd3, 0xf4, 0xb9, 0xa7, 0xf8, 0x7f, 0xb9,
  0x07, 0xc5, 0x1e, 0x5d, 0x23, 0xb1, 0x9f, 0x23, 0x9e, 0x36, 0x34, 0xf3,
  0xd3, 0xf4, 0x7e, 0xff, 0x00, 0xe1, 0x34, 0xd4, 0xd6, 0x3a, 0x7f, 0x0c,
  0x26, 0xdf, 0x4d, 0x92, 0xf1, 0x21, 0x5d, 0x33, 0xc4, 0xa9, 0xdb, 0x33,
  0xbd, 0xfb, 0xc9, 0xe3, 0x63, 0x86, 0xbd, 0x25, 0xa4, 0xea, 0x56, 0x92,
  0xe1, 0xd9, 0x45, 0x3b, 0xc6, 0x2b, 0x65, 0xf6, 0x76, 0xbe, 0x9f, 0x53,
  0xa7, 0x0a, 0xb2, 0x4d, 0x1c, 0x32, 0x5c, 0x2c, 0x8e, 0xec, 0x14, 0xd5,
  0x84, 0x5a, 0x67, 0xda, 0xcf, 0x84, 0x44, 0x7d, 0x24, 0x38, 0x56, 0x57,
  0x2a, 0xda, 0x6b, 0x4c, 0xa8, 0x54, 0xe0, 0x5d, 0x5d, 0x45, 0x49, 0x27,
  0xbe, 0xed, 0xfe, 0xbb, 0x49, 0xfa, 0xf3, 0xc8, 0xa0, 0x69, 0x5a, 0x54,
  0x6a, 0x63, 0x1a, 0xad, 0x08, 0xc9, 0xc6, 0x31, 0xe0, 0xa9, 0x2b, 0xae,
  0x0b, 0xbd, 0xdd, 0x9e, 0xdc, 0xfc, 0xbb, 0x56, 0x98, 0x5b, 0x8a, 0x3e,
  0xd3, 0x5a, 0x2b, 0x49, 0xaa, 0x99, 0xdd, 0x27, 0xb2, 0xd9, 0x6e, 0xdc,
  0xc9, 0xc8, 0x54, 0xba, 0xc9, 0x22, 0x1f, 0x07, 0x80, 0xc3, 0x47, 0x93,
  0x46, 0x9a, 0xfa, 0x60, 0x95, 0xfb, 0x89, 0x07, 0x42, 0x8e, 0xce, 0x2e,
  0x3d, 0xc4, 0x21, 0x2b, 0xcc, 0x4a, 0x73, 0x40, 0x4d, 0xf1, 0x99, 0x2d,
  0xa9, 0xa9, 0x76, 0x6c, 0x7d, 0xe5, 0x88, 0x87, 0xd5, 0xea, 0x50, 0x8a,
  0x9c, 0x60, 0xac, 0x93, 0x4e, 0xf9, 0xb7, 0x9d, 0xf2, 0xbb, 0xdc, 0x4b,
  0xb6, 0x6b, 0xc3, 0xfd, 0x5e, 0x57, 0x53, 0x3b, 0xc9, 0x28, 0x2d, 0x67,
  0xc4, 0xc9, 0x28, 0x53, 0x87, 0xc5, 0x79, 0x3e, 0x94, 0xad, 0x65, 0xfa,
  0xe6, 0x20, 0x6e, 0xf7, 0x9e, 0xf1, 0xda, 0x61, 0xd4, 0xaa, 0xdd, 0xbd,
  0xdb, 0x5a, 0x3f, 0x4a, 0x34, 0x4a, 0xb7, 0x43, 0x33, 0x65, 0xbe, 0xed,
  0xf4, 0xd9, 0x86, 0x9f, 0x1a, 0x7d, 0xb7, 0xa9, 0x98, 0x55, 0x5f, 0x39,
  0xce, 0xe6, 0xcf, 0x4b, 0xac, 0xab, 0x6b, 0x74, 0xd8, 0xe4, 0xf3, 0xb9,
  0xab, 0x8d, 0x30, 0xe6, 0x8d, 0x15, 0x2a, 0xa2, 0x33, 0x64, 0xe2, 0xad,
  0x8e, 0xbb, 0x33, 0xc7, 0xf3, 0x9c, 0x33, 0xc4, 0x47, 0x9f, 0x63, 0x34,
  0xbc, 0x42, 0x21, 0xb4, 0xb4, 0x92, 0x75, 0x8d, 0x6e, 0xb9, 0x19, 0x3c,
  0x67, 0x51, 0xe1, 0x57, 0xbe, 0xf3, 0x9b, 0x34, 0x93, 0x78, 0xb3, 0xcb,
  0xc5, 0xa2, 0x3d, 0xc9, 0x6f, 0x35, 0x71, 0xbc, 0xc3, 0x66, 0x92, 0xaf,
  0x14, 0x78, 0x78, 0xa2, 0x35, 0xd5, 0x30, 0xab, 0x0d, 0xbb, 0xa4, 0xac,
  0x71, 0x26, 0x5d, 0x72, 0x2e, 0x15, 0x6c, 0x67, 0x8f, 0x1b, 0x34, 0x96,
  0x55, 0x4c, 0x11, 0xd1, 0xc4, 0x19, 0x1f, 0x27, 0x34, 0xb4, 0x29, 0x9e,
  0x95, 0x52, 0x3f, 0xda, 0x04, 0x71, 0x05, 0xbb, 0x55, 0xa4, 0x87, 0x18,
  0x67, 0x8e, 0x38, 0x3d, 0xa0, 0x71, 0xe7, 0x36, 0x69, 0x28, 0xa6, 0x8f,
  0x4a, 0xcc, 0x8a, 0x55, 0xcf, 0x70, 0xc4, 0x9d, 0xd9, 0xa4, 0x84, 0x92,
  0xdc, 0x6a, 0x9b, 0x7c, 0xc6, 0x85, 0x88, 0x47, 0xbe, 0x3d, 0x0d, 0x9a,
  0x62, 0x52, 0x6b, 0x62, 0x3c, 0xac, 0x45, 0xf6, 0xa3, 0x12, 0xaa, 0xb9,
  0xce, 0x4a, 0xb5, 0x2d, 0x7e, 0xaf, 0x31, 0xb7, 0x74, 0xf7, 0x16, 0xb8,
  0xcb, 0x73, 0x22, 0x4e, 0x8c, 0x77, 0x95, 0xcc, 0x0e, 0x22, 0xf5, 0x25,
  0x7e, 0x8e, 0xe2, 0x7a, 0x95, 0x52, 0x75, 0x94, 0xe6, 0x1b, 0xab, 0x3c,
  0x8f, 0x9a, 0xeb, 0x26, 0x12, 0x53, 0xc6, 0xc1, 0xc2, 0xa3, 0xa7, 0x28,
  0xc5, 0x59, 0xa4, 0x9d, 0xd3, 0x6d, 0x34, 0xd3, 0xda, 0xb2, 0xd9, 0xd4,
  0x7d, 0x29, 0x67, 0x72, 0x8b, 0x8d, 0xd1, 0x91, 0xad, 0x8c, 0x7c, 0x29,
  0x4e, 0x12, 0x83, 0xbc, 0x65, 0x1b, 0x72, 0x5a, 0x5b, 0x9a, 0xb3, 0xcf,
  0xc0, 0x96, 0xf4, 0xed, 0x62, 0x13, 0x38, 0x3c, 0x1d, 0x68, 0xec, 0xab,
  0x4a, 0x7f, 0x54, 0x5c, 0x1f, 0x7a, 0x6f, 0xc0, 0xeb, 0x9d, 0x0c, 0x46,
  0x4f, 0x81, 0x45, 0xf5, 0x56, 0x7e, 0x70, 0xf3, 0x35, 0xac, 0x35, 0x5a,
  0x5b, 0x57, 0x1b, 0x15, 0xf1, 0x43, 0x94, 0xbe, 0xa8, 0x7a, 0x5c, 0xdb,
  0x4f, 0x17, 0xc2, 0x6b, 0x81, 0x77, 0x9f, 0x05, 0xab, 0x3b, 0xa7, 0xcd,
  0x6d, 0xb7, 0xe8, 0x39, 0x08, 0x2e, 0x5a, 0x12, 0x09, 0x53, 0x5f, 0x33,
  0xe5, 0x74, 0x4a, 0xdb, 0x17, 0x41, 0xdf, 0x38, 0xdd, 0x34, 0xf7, 0xab,
  0x77, 0x9c, 0x5a, 0x1e, 0x84, 0xa3, 0x0f, 0x7f, 0x27, 0x27, 0x7b, 0x3d,
  0xca, 0xd6, 0x49, 0x9d, 0xc6, 0xda, 0x7f, 0x58, 0x79, 0x39, 0x67, 0xf9,
  0xcc, 0xc3, 0xe7, 0x5e, 0xd3, 0x4a, 0x8c, 0xa5, 0x49, 0xca, 0xf2, 0x8c,
  0xa4, 0xae, 0xd6, 0xdb, 0x3b, 0x64, 0x7b, 0x85, 0x74, 0xf3, 0x44, 0x4e,
  0x95, 0xc2, 0x5e, 0xbd, 0x48, 0xcd, 0x35, 0x3a, 0x72, 0x77, 0xe9, 0x4d,
  0xbb, 0x3f, 0xd7, 0x39, 0xd3, 0x0a, 0x72, 0x8a, 0xdb, 0x63, 0x05, 0xfe,
  0xa5, 0xea, 0xd3, 0x53, 0x58, 0x75, 0xd4, 0xa9, 0xce, 0x73, 0xce, 0xb7,
  0x32, 0xef, 0x3c, 0x46, 0xef, 0x69, 0x9b, 0x58, 0x82, 0x7a, 0x78, 0x9d,
  0x63, 0x8f, 0x13, 0x88, 0xe6, 0x37, 0x62, 0x13, 0xb3, 0x23, 0xfd, 0x9e,
  0x73, 0x92, 0x8c, 0x22, 0xdb, 0x93, 0x49, 0x25, 0xb5, 0xb7, 0xb8, 0x8e,
  0xa6, 0x65, 0xdd, 0xc4, 0x39, 0x2b, 0x62, 0xac, 0xdf, 0x79, 0xa7, 0xda,
  0xdb, 0xca, 0x39, 0xbe, 0x65, 0x9f, 0xe4, 0x7d, 0x47, 0x40, 0xea, 0x6d,
  0x0a, 0x51, 0x52, 0xc4, 0x42, 0x15, 0x6a, 0xbc, 0xdb, 0x92, 0xe1, 0x42,
  0x1d, 0x11, 0x8b, 0xcb, 0xb5, 0xe7, 0xd5, 0xb0, 0xb2, 0x52, 0xa1, 0x18,
  0xe5, 0x08, 0xc6, 0x3f, 0x4a, 0x4b, 0xc0, 0xd9, 0x4e, 0x9b, 0xeb, 0xed,
  0x8e, 0xfd, 0x6c, 0x44, 0xff, 0x00, 0x18, 0x7c, 0x52, 0x8e, 0x8f, 0xc5,
  0x4b, 0x93, 0x87, 0xae, 0xff, 0x00, 0xda, 0x9f, 0xa1, 0x99, 0x68, 0x6c,
  0x6e, 0xdf, 0x66, 0xaf, 0xd9, 0x4e, 0x5e, 0x87, 0xdb, 0x81, 0x3f, 0x1a,
  0xaa, 0xbc, 0xdb, 0x70, 0xf8, 0x73, 0xc2, 0x62, 0xe3, 0xb6, 0x85, 0x75,
  0xd7, 0x4a, 0x7e, 0x87, 0x3d, 0x49, 0xd5, 0x8f, 0x2e, 0x12, 0x5f, 0x54,
  0x5a, 0xf1, 0x3e, 0xf2, 0x61, 0xa2, 0x3e, 0x2d, 0x79, 0x77, 0xcc, 0xb7,
  0x0f, 0x81, 0x7b, 0x54, 0x98, 0x58, 0x99, 0x1f, 0x73, 0xaf, 0xa3, 0x28,
  0x4f, 0xfc, 0xca, 0x34, 0xa5, 0x7f, 0x9a, 0x9c, 0x5f, 0x8a, 0x23, 0xb1,
  0x1a, 0xa3, 0x82, 0x9e, 0xdc, 0x3c, 0x57, 0xd0, 0xe5, 0x0f, 0xfa, 0xb4,
  0x46, 0x7a, 0x5f, 0xf5, 0x38, 0xeb, 0x79, 0x87, 0xc7, 0xfd, 0xad, 0x85,
  0x8c, 0x3e, 0x97, 0x89, 0xff, 0x00, 0x0e, 0xf0, 0xb2, 0xe4, 0x4e, 0xac,
  0x3b, 0x63, 0x25, 0xf9, 0xab, 0xfe, 0x64, 0x56, 0x27, 0xfc, 0x34, 0x7b,
  0x69, 0xe2, 0x22, 0xfa, 0x27, 0x4d, 0xaf, 0xcd, 0x37, 0xe0, 0x42, 0x7a,
  0x6b, 0x27, 0x1d, 0x5d, 0x25, 0x4d, 0xa7, 0x8e, 0x04, 0xed, 0x5d, 0x40,
  0xc6, 0x45, 0xe5, 0x1a, 0x73, 0xe9, 0x8d, 0x45, 0xff, 0x00, 0xab, 0x02,
  0xbe, 0xc5, 0xb8, 0x59, 0xe4, 0x53, 0x94, 0xca, 0xd5, 0xfc, 0x57, 0xf0,
  0x9f, 0x6c, 0xe1, 0xfd, 0x46, 0xd8, 0x6a, 0xd6, 0x2b, 0xe5, 0x8a, 0xeb,
  0x9c, 0x7c, 0x8b, 0xe8, 0x35, 0xf8, 0xd4, 0x61, 0xf2, 0xae, 0xa4, 0x47,
  0x55, 0xf1, 0x2f, 0x6b, 0xa6, 0xba, 0xe4, 0xfc, 0x91, 0xba, 0x1a, 0xa7,
  0x5b, 0x7d, 0x4a, 0x6b, 0xa9, 0x49, 0xfa, 0x17, 0x10, 0x4b, 0xc7, 0xa2,
  0x3e, 0x4e, 0x45, 0x5a, 0x1a, 0xa4, 0xfe, 0x2a, 0xdd, 0xd4, 0xfd, 0x64,
  0x6f, 0x86, 0xaa, 0x41, 0x6d, 0xab, 0x51, 0xf5, 0x28, 0xaf, 0x22, 0xc4,
  0x0e, 0xf6, 0x69, 0xc2, 0x3d, 0xfc, 0x9c, 0xa0, 0xd6, 0xac, 0x52, 0xf9,
  0xea, 0xf7, 0xc7, 0xfa, 0x4f, 0x4b, 0x56, 0x68, 0xf3, 0xd4, 0xfc, 0x4b,
  0xd0, 0x9a, 0x04, 0xbb, 0x74, 0xe1, 0xce, 0xed, 0xf9, 0x44, 0x7e, 0xce,
  0xd0, 0xe6, 0x9b, 0xfe, 0x66, 0x69, 0xab, 0xaa, 0xf4, 0x1e, 0xc7, 0x51,
  0x75, 0x49, 0x79, 0xa2, 0x74, 0x0e, 0xdd, 0x78, 0x3b, 0xb7, 0xe5, 0x53,
  0xab, 0xa9, 0xc9, 0x5d, 0xd2, 0xa9, 0x9b, 0xdd, 0x35, 0xe6, 0xbd, 0x08,
  0xbc, 0x46, 0x0e, 0xb5, 0x17, 0xf6, 0x90, 0x95, 0xbe, 0x68, 0xfb, 0xd1,
  0xef, 0x5b, 0x3b, 0x4f, 0xa0, 0x18, 0xb1, 0x19, 0xc3, 0x5f, 0xc5, 0xb5,
  0xea, 0xaf, 0x1e, 0xfe, 0xd4, 0x2c, 0x3e, 0x35, 0x1c, 0x1a, 0x5b, 0x0f,
  0x76, 0xea, 0xc1, 0x7b, 0xd1, 0x8b, 0x76, 0xbd, 0xaf, 0x6c, 0xec, 0x7d,
  0x1a, 0xa6, 0x0e, 0x9c, 0xb3, 0x95, 0x38, 0x3e, 0xb8, 0x45, 0xf9, 0x1e,
  0x25, 0xa3, 0xa8, 0xbc, 0xb8, 0xaa, 0x7f, 0x82, 0x3e, 0x84, 0x27, 0x04,
  0xf2, 0xb6, 0x3a, 0xc8, 0xe1, 0x42, 0xc1, 0xe3, 0x24, 0xfd, 0xdb, 0x34,
  0xf9, 0x9e, 0xfe, 0xae, 0x72, 0xe9, 0xa0, 0xf0, 0xb2, 0x84, 0x1b, 0x9a,
  0xb3, 0x9d, 0xb2, 0xde, 0x92, 0xe7, 0xe9, 0x24, 0x29, 0xd2, 0x8c, 0x52,
  0x51, 0x8a, 0x49, 0x6c, 0x49, 0x5a, 0xdd, 0x47, 0xb2, 0x74, 0xc5, 0xf1,
  0x9d, 0xa9, 0xcb, 0x9e, 0x6f, 0x1a, 0xd0, 0x00, 0x2d, 0x67, 0x52, 0xf5,
  0xca, 0xab, 0x85, 0x64, 0xde, 0xc7, 0x49, 0x38, 0xf4, 0xd9, 0xbb, 0xaf,
  0xd7, 0x39, 0x53, 0xff, 0x00, 0xed, 0xdd, 0xfb, 0xf1, 0xb1, 0xf5, 0x6d,
  0x21, 0xa3, 0xe9, 0x57, 0x8f, 0x06, 0xb4, 0x14, 0x96, 0xd5, 0xb9, 0xa7,
  0xce, 0x9a, 0xcd, 0x11, 0x38, 0x7d, 0x4e, 0xc1, 0xc5, 0xb6, 0xe9, 0x39,
  0xdd, 0x5b, 0xed, 0x27, 0x29, 0x25, 0xd4, 0x9b, 0xb7, 0x69, 0x9e, 0xf8,
  0x7e, 0x53, 0xb6, 0xcc, 0x5d, 0x4c, 0x56, 0xba, 0x98, 0x51, 0x69, 0x69,
  0x18, 0x3d, 0x8d, 0x1e, 0xde, 0x2d, 0x6e, 0x2d, 0x78, 0xed, 0x45, 0xc1,
  0x38, 0xc9, 0xc5, 0x54, 0xa7, 0x93, 0x77, 0x85, 0x47, 0x95, 0x97, 0x34,
  0xae, 0xac, 0x7c, 0xdf, 0x46, 0x61, 0xe7, 0x93, 0x9b, 0x79, 0xee, 0xe6,
  0x28, 0xbe, 0x39, 0xaf, 0xb6, 0xac, 0x79, 0x63, 0x27, 0xa4, 0xdb, 0x9b,
  0x65, 0x9b, 0x52, 0x74, 0x72, 0x72, 0x95, 0x79, 0x2e, 0x47, 0xbb, 0x1f,
  0xa9, 0xf2, 0x9f, 0x62, 0x76, 0xed, 0x65, 0x67, 0x0e, 0xf8, 0x52, 0x8d,
  0x38, 0x2b, 0xca, 0x52, 0x51, 0x4b, 0xa5, 0xbb, 0x1f, 0x4f, 0xd1, 0xb8,
  0x35, 0x46, 0x94, 0x29, 0xc7, 0xe1, 0x8d, 0x9b, 0xe7, 0x96, 0xd6, 0xfb,
  0x5d, 0xc9, 0x60, 0xa6, 0xe7, 0x6a, 0xba, 0xac, 0x9a, 0xaf, 0xc6, 0x3f,
  0x5d, 0x40, 0x03, 0x6b, 0xce, 0x00, 0x00, 0x00, 0x00, 0x00, 0x00, 0x00,
  0x00, 0x00, 0x00, 0x00, 0x00, 0x00, 0x00, 0x00, 0x00, 0x00, 0x00, 0x00,
  0x00, 0x00, 0x00, 0x00, 0x00, 0x00, 0x00, 0x00, 0x00, 0x00, 0x00, 0x44,
  0xeb, 0x2e, 0x27, 0x83, 0x45, 0xc5, 0x3c, 0xea, 0xfb, 0x9f, 0xcb, 0xf1,
  0x3e, 0xec, 0xbb, 0x4a, 0x16, 0x29, 0x46, 0x29, 0xbc, 0xb2, 0x2c, 0xba,
  0xd9, 0x88, 0xfb, 0x55, 0x16, 0xec, 0xa1, 0x4f, 0xf3, 0x93, 0x77, 0xf0,
  0x44, 0x4e, 0xac, 0xe0, 0x16, 0x23, 0x13, 0x79, 0xe7, 0x0a, 0x0b, 0x8c,
  0xda, 0xda, 0x94, 0xef, 0xee, 0xa7, 0xf9, 0xbb, 0x7d, 0xd3, 0x26, 0x4d,
  0xda, 0xff, 0x00, 0x18, 0x7a, 0x58, 0x75, 0x8f, 0x0f, 0xca, 0x53, 0xba,
  0xa3, 0xab, 0xea, 0x92, 0x55, 0xea, 0xc7, 0xed, 0x66, 0xae, 0x93, 0xfd,
  0xd4, 0x5e, 0xeb, 0x7c, 0xcd, 0x6d, 0x7d, 0x36, 0xe7, 0xbd, 0x9c, 0x03,
  0x55, 0x6b, 0x15, 0x8d, 0x43, 0xcf, 0xbd, 0xe6, 0xd3, 0xb9, 0x00, 0x07,
  0x51, 0x00, 0x00, 0x00, 0x00, 0x00, 0x00, 0x00, 0x00, 0x00, 0x00, 0x00,
  0x00, 0x00, 0x00, 0x00, 0x00, 0x00, 0x00, 0x00, 0x00, 0x00, 0x00, 0x00,
  0x00, 0x00, 0x00, 0x00, 0x00, 0x00, 0x00, 0x53, 0xb5, 0xc3, 0x0f, 0xf6,
  0xb1, 0x72, 0xe4, 0xd4, 0x82, 0x57, 0xe9, 0x8b, 0x77, 0x57, 0xe7, 0xb3,
  0x44, 0x86, 0xa5, 0x61, 0x23, 0x0a, 0x33, 0x71, 0x56, 0xe1, 0xd5, 0x7b,
  0xdb, 0xc9, 0x24, 0x96, 0x6f, 0xb4, 0x99, 0xc6, 0xe0, 0xe9, 0xd5, 0x8f,
  0x02, 0xac, 0x54, 0xa2, 0xf3, 0xb3, 0xdc, 0xd6, 0xc6, 0xb9, 0x9f, 0x4a,
  0x3d, 0x61, 0x70, 0xd0, 0xa7, 0x15, 0x0a, 0x71, 0x51, 0x8c, 0x76, 0x25,
  0xfd, 0xf6, 0x95, 0xc5, 0x35, 0x6d, 0xb4, 0x5b, 0x36, 0xf1, 0x45, 0x1b,
  0x80, 0x05, 0x8c, 0xe0, 0x00, 0x00, 0x00, 0x00, 0x00, 0x00, 0x00, 0x00,
  0x00, 0x00, 0x00, 0x00, 0x00, 0x00, 0x00, 0x00, 0x00, 0x00, 0x00, 0x00,
  0x00, 0x00, 0x00, 0x00, 0x00, 0x00, 0x00, 0x00, 0x00, 0x00, 0x00, 0x00,
  0x00, 0x00, 0x00, 0x00, 0x00, 0x00, 0x00, 0x00, 0x00, 0x00, 0x00, 0x00,
  0x00, 0x00, 0x00, 0x00, 0x00, 0x00, 0x00, 0x00, 0x00, 0x00, 0x00, 0x00,
  0x00, 0x00, 0x00, 0x00, 0x00, 0x00, 0x00, 0x00, 0x00, 0x00, 0x00, 0x00,
  0x00, 0x00, 0x00, 0x00, 0x00, 0x00, 0x00, 0x00, 0x00, 0x00, 0x00, 0x00,
  0x00, 0x00, 0x00, 0x0f, 0xff, 0xd9
};
unsigned int image_jpeg_len = 2910;
```

## src/output_handler.cc
```c
#include "output_handler.hpp"
#include <tensorflow/lite/micro/micro_log.h>

//Output String displayed based on the index of the result
const char* kGestureLabels[kGestureCount] = {
    "Class 0",
    "Class 1",
    "Class 2",
    "Class 3",
    "Class 4",
    "Class 5",
    "Class 6",
    "Class 7",
    "Class 8",
    "Class 9",
    "Class 10",
    "Class 11",
    "Class 12",
    "Class 13",
    "Class 14",
    "Class 15",
    "Class 16",
    "Class 17",
    "Class 18",
    "Class 19"
};


void HandleOutput(int gesture_class) {
    if (gesture_class >= 0 && gesture_class < kGestureCount) {
        MicroPrintf("Detected: %s", kGestureLabels[gesture_class]);
    } else {
        MicroPrintf("Unknown gesture");
    }
}
```

## src/output_handler.hpp
```c
#ifndef OUTPUT_HANDLER_HPP
#define OUTPUT_HANDLER_HPP

#include "constants.hpp"

void HandleOutput(int gesture_class);

#endif // OUTPUT_HANDLER_H
```

## src/zephyr_const_includers.h
```c
#ifdef __cplusplus
extern "C" {
#endif

extern const unsigned char zephyr_quantized_int8_tflite[];  //me to extern tha koitaksei sto model_data.cc package gia na vrei ta variables.
extern const unsigned int zephyr_quantized_int8_tflite_len;

#ifdef __cplusplus
}
#endif
```
